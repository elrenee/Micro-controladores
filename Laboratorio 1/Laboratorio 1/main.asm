; Prelab 01.asm
; Created: 2/02/2025 16:12:04
; Author : RENи GONZаLEZ, 23365
;
.include "M328PDEF.inc"

.cseg //lo que sigue es codigo
.org 0x0000
// coonfigurams la pila
LDI R16, LOW(RAMEND)
OUT SPL, R16
LDI R16, HIGH(RAMEND)
OUT SPH, R16
//configuramos el MCU
SETUP:
	//Seteamos los pines de entrada y salida

	LDI R16, 0x00
	OUT DDRB, R16  //Seteamos el puerto B como entrada 
	LDI R16, 0Xff
	OUT PORTB, R16 //HABLITAMOS PULL-UP
	
	OUT DDRD, R16//SETEAMOS EL PUERTO D COMO SALIDA
	LDI R16, 0X00
	OUT PORTD, R16// CONFIGURAMOS 0V EN CADA PIN DEL PUERTO D

	LDI R16, 0xFF
	OUT	DDRC, R16//SETEAMOS EL PUERTO C COMO SALIDA
	LDI R16, 0x00
	OUT PORTC, R16 //0V EN EL PUERTO C


	LDI		R18,0X00 //CONTADOR UNO A 0
	LDI		R17, 0x00 //Contador DOS A 0
	LDI		R19, 0XFF // ESTADO ACTUAL 
	LDI		R22, 0x00// Salida contador 1 y 2
	LDI		R21, 0X00 //resultado de la suma

Loop:
	IN		R16, PINB
	CP 		R19, R16
	BREQ	Loop
	MOV		R19, R16
	SBIS	PINB, 0
	CALL	MAIN
	SBIS	PINB, 1
	CALL	MAIN2
	SBIS	PINB, 2
	CALL	MAIN3
	SBIS	PINB, 3
	CALL	MAIN4
	SBIS	PINB, 4
	CALL	RESULTADO
	DEFAULT:
		JMP Loop

Main:
	CALL	TIEMPO
	IN		R16, PINB
	SBIS	PINB, 0
	CALL	SUMAR
	RET

Main2:
	CALL	TIEMPO
	IN		R16, PINB
	SBIS	PINB, 1
	CALL	RESTAR
	RET

MAIN3:
	CALL	TIEMPO
	IN		R16, PINB
	SBIS	PINB, 2
	CALL	SUMAR2
	RET

MAIN4:
	CALL	TIEMPO
	IN		R16, PINB
	SBIS	PINB, 3
	CALL	RESTAR2
	RET

RESULTADO:
		CALL	TIEMPO
		IN		R16, PINB
		SBIS	PINB, 4
		CALL	SUMAR_AMBOS
		RET




SUMAR_AMBOS:
		SWAP	R17
		CLR		R21
		ADD		R21, R17
		ADD		R21, R18
		SWAP	R17
		OUT		PORTC, R21
		RET
		 


SUMAR:
		SBRS	R16, 0
		INC		R18
		CALL	evitar_carry
		CLR		R22
		ADD		R22, R18
		ADD		R22,R17
		OUT		PORTD, R22
		RET
evitar_carry:
		CPI		R18, 0x10
		BREQ	LIMPIAR
		RET
LIMPIAR:
		CLR		R18
		RET



RESTAR:
		SBRS	R16, 1
		DEC		R18
		CALL	Evitar_underflow
		CLR		R22
		ADD		R22, R18
		ADD		R22,R17
		OUT		PORTD, R22
		RET
Evitar_underflow:
		CPI	R18, 0XFF
		BREQ CARGAR_VALOR
		RET
CARGAR_VALOR:
		LDI	R18, 0X0F
		RET



SUMAR2:
		SBRS	R16, 2 
		SWAP	R17    
		INC		R17
		CALL	EVITAR_CARRY2
		SWAP	R17
		CLR		R22
		ADD		R22, R17
		ADD		R22, R18
		OUT		PORTD, R22
		RET
EVITAR_CARRY2:
		CPI R17, 0X10
		BREQ LIMPIAR2
		RET
LIMPIAR2:
		CLR R17
		RET


RESTAR2:
		SBRS	R16, 3   
		SWAP	R17
		DEC		R17
		CALL	EVITAR_UNDERFLOW2
		SWAP	R17
		CLR		R22
		ADD		R22, R17
		ADD		R22, R18
		OUT		PORTD,  R22
		RET
EVITAR_UNDERFLOW2:
		CPI		R17, 0XFF
		BREQ	CARGAR_VALOR2
		RET
CARGAR_VALOR2:
		LDI R17,0X0F
		RET


TIEMPO:
	LDI		R20, 0x00
	LDI		R22, 0
SUB_DELAY1:
	INC		R20
	CPI		R20, 0
	BRNE	SUB_DELAY1
	INC		R22
	CPI		R22, 0
	BRNE	SUB_DELAY1
	RET