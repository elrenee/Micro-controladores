;
; RELOJ.asm
;
; Created: 9/03/2025 16:54:19
; Author : Barbaritos
;

.include "M328PDEF.inc"
.equ Modos =5 //Reloj, Fecha, Configurar R, configurar F, Alarma
.DEF Modo = R20




.cseg //lo que sigue es codigo
.org 0x0000
// coonfigurams la pila
LDI R16, LOW(RAMEND)
OUT SPL, R16
LDI R16, HIGH(RAMEND)
OUT SPH, R16

SETUP:
	Tabla7seg: .DB 0x3F, 0x06, 0x5B, 0x4F, 0x66, 0x6D, 0x7D, 0x07, 0x7F, 0x6F

	CLR MODO

	LDI R30, 0X00 ;ME AYUDARA PARA CORRER Z DEPENDIENDO EL VALOR QUE QUIERO MOSTRAR

	LDI		ZL, LOW(Tabla7seg<<1)
	LDI		ZH, HIGH(Tabla7seg<<1)
	LDI		R16, 0X00
	LDI		R29, 0X00 //SERA DONDE PONDRE EL VALOR QUE QUIERO MOSTRAR EN EL DISPLAY
	LDI		R30, 0X00 ;ME AYUDARA PARA CORRER Z DEPENDIENDO EL VALOR QUE QUIERO MOSTRAR

MAINLOOP:
	CPI		MODO, 0
	BREQ	HORA
	CPI		MODO, 1
	;BREQ	CONF_HORA
	CPI		MODO, 2
	BREQ	FECHA1
	CPI		MODO,3
	;BREQ	CONF_FECHA
	CPI		MODO, 4
	BREQ	ALARMA1
	RJMP	MAINLOOP

FECHA1: 
	JMP FECHA

ALARMA1:
	JMP ALARMA

HORA:
	LDI		ZL, LOW(Tabla7seg<<1)
	LDI		ZH, HIGH(Tabla7seg<<1)
	CBI		PORTC, 0 
	CBI		PORTC, 1
	CBI		PORTC, 2
	CBI		PORTC, 3
	CALL	DECENAHORA
	SBI		PORTC, 0
	OUT		PORTD, R29
	CALL	UNIHORA
	CBI		PORTC, 0 
	SBI		PORTC, 1
	OUT		PORTD, R29
	CALL	DECENAMIN
	CBI		PORTC, 1 
	SBI		PORTC, 2
	OUT		PORTD, R29
	CALL	UNIDADMIN
	CBI		PORTC, 2
	SBI		PORTC, 3
	OUT		PORTD, R29
	RJMP	MAINLOOP  // NOO SE SI RET O RJMP A HORA DE NUEVO, Y PONER UN COMPARADOR PARA QUE SE EJECUTE RET SOLO SI SE CAMBIO EL MODO 

DECENAHORA:
	;LDS R16, DECHOUR  //DECHOUR SOLO LO INCREMENTARE EN LA INTERRUPCION DEL TIMER, SI Y SOLO SI YA PASARON 10 HORAS
	CPSE	R30, R16
	ADIW	Z, 1
	CPSE	R30, R16
	INC		R30
	CP		R30, R24
	BRNE	DECENAHORA
	LPM		R29, Z
	CLR		R30
	RET

UNIHORA:
	LDI		ZL, LOW(Tabla7seg<<1)
	LDI		ZH, HIGH(Tabla7seg<<1) //RESETEAMOS HACCIA DONDE ESTA APUNTANDO Z 
	;LDS	R16, UHOUR
	CPSE	R30, R16
	ADIW	Z, 1
	CPSE	R30, R16
	INC		R30
	CP		R30, R16
	BRNE	UNIHORA
	LPM		R29, Z
	CLR		R30
	RET

DECENAMIN:
	LDI		ZL, LOW(Tabla7seg<<1)
	LDI		ZH, HIGH(Tabla7seg<<1) // RESETEAMOS A DONDE APUNTA Z
	;LDS	R16, DECMIN
	CPSE	R30, R16
	ADIW	Z, 1
	CPSE	R30, R16
	INC		R30
	CP		R30, R16
	BRNE	DECENAMIN
	LPM		R29, Z
	CLR		R30
	RET 


UNIDADMIN:
	LDI		ZL, LOW(Tabla7seg<<1)
	LDI		ZH, HIGH(Tabla7seg<<1)// RESETEAMOS A DONDE APUNTA Z
	;LDS	R16, UNIMIN
	CPSE	R30, R16
	ADIW	Z, 1
	CPSE	R30, R16
	INC		R30
	CP		R30, R16
	BRNE	UNIDADMIN
	LPM		R29, Z
	CLR		R30
	RET 


//SEGUNDO MODO, CONFIGURACIсN DE LA HORA 



// TERCER MODO, MOSTRAR LA FECHA EN LOS DISPLAYS!!!!!!
FECHA:
	LDI		ZL, LOW(Tabla7seg<<1)
	LDI		ZH, HIGH(Tabla7seg<<1)
	CBI		PORTC, 0
	CBI		PORTC, 1
	CBI		PORTC, 2
	CBI		PORTC, 3
	CALL	DECENAMES
	SBI		PORTC, 0
	OUT		PORTC, R29
	CALL	UNIDADMES
	CBI		PORTC, 0
	SBI		PORTC, 1
	OUT		PORTC, R29
	CALL	DECENADIAS 
	CBI		PORTC, 1
	SBI		PORTC, 2
	OUT		PORTC, R29
	CALL	UNIDADDIAS
	CBI		PORTC, 2
	SBI		PORTC, 3
	OUT		PORTC, R29
	RJMP	MAINLOOP //NO SE SI RET O RJMP A FECHA 


DECENAMES:
	;LDS R16, DECMES
	CPSE	R30, R16
	ADIW	Z, 1
	CPSE	R30, R16
	INC		R30
	CP		R30, R16
	BRNE	DECENAMES 
	LPM		R29, Z
	CLR		R30
	RET

UNIDADMES:
	LDI		ZL, LOW(Tabla7seg<<1)
	LDI		ZH, HIGH(Tabla7seg<<1)
	;LDS	R16, UNIMES
	CPSE	R30, R16
	ADIW	Z, 1
	CPSE	R30, R16
	INC		R30
	CP		R30, R16
	BRNE	UNIDADMES 
	LPM		R29, Z
	CLR		R30
	RET


DECENADIAS:
	LDI		ZL, LOW(Tabla7seg<<1)
	LDI		ZH, HIGH(Tabla7seg<<1)
	;LDS	R16, DECDIAS
	CPSE	R30, R16
	ADIW	Z, 1
	CPSE	R30, R16
	INC		R30
	CP		R30, R16
	BRNE	DECENADIAS 
	LPM		R29, Z
	CLR		R30
	RET

UNIDADDIAS:
	LDI		ZL, LOW(Tabla7seg<<1)
	LDI		ZH, HIGH(Tabla7seg<<1)
	;LDS	R16, UNIDIAS
	CPSE	R30, R16
	ADIW	Z, 1 
	CPSE	R30, R16
	INC		R30
	CP		R30, R16 
	BRNE	UNIDADDIAS
	LPM		R29, Z
	CLR		R30
	RET 


//CUARTO MODO,  ALARMA. 
ALARMA: 
	//4 CONTADORES, Y CUANDO EL TIMER INCREMENTE MINUTO, DECENA DE MIN, HORA Y DECENA DE HORA, A SU VEZ COMPARARа SI ES IGUAL A LOS CONTADORES DE ES EL 
	LDI		ZL, LOW(Tabla7seg<<1)
	LDI		ZH, HIGH(Tabla7seg<<1)
	CBI		PORTC, 0 
	CBI		PORTC, 1
	CBI		PORTC, 2
	CBI		PORTC, 3
	CALL	DECENAHORALARMA
	SBI		PORTC, 0
	OUT		PORTD, R29
	CALL	UNIHORALARMA
	CBI		PORTC, 0 
	SBI		PORTC, 1
	OUT		PORTD, R29
	CALL	DECENAMINALARMA
	CBI		PORTC, 1 
	SBI		PORTC, 2
	OUT		PORTD, R29
	CALL	UNIDADMINALARMA
	CBI		PORTC, 2
	SBI		PORTC, 3
	OUT		PORTD, R29
	RJMP	MAINLOOP  // NOO SE SI RET O RJMP A HORA DE NUEVO, Y PONER UN COMPARADOR PARA QUE SE EJECUTE RET SOLO SI SE CAMBIO EL MODO 

DECENAHORALARMA:
	;LDS R16, DECHOURALARM  //DECHOUR SOLO LO INCREMENTARE EN LA INTERRUPCION DEL TIMER, SI Y SOLO SI YA PASARON 10 HORAS
	CPSE	R30, R16
	ADIW	Z, 1
	CPSE	R30, R16
	INC		R30
	CP		R30, R24
	BRNE	DECENAHORALARMA
	LPM		R29, Z
	CLR		R30
	RET

UNIHORALARMA:
	LDI		ZL, LOW(Tabla7seg<<1)
	LDI		ZH, HIGH(Tabla7seg<<1) //RESETEAMOS HACCIA DONDE ESTA APUNTANDO Z 
	;LDS	R16, UHOURALARM
	CPSE	R30, R16
	ADIW	Z, 1
	CPSE	R30, R16
	INC		R30
	CP		R30, R16
	BRNE	UNIHORALARMA
	LPM		R29, Z
	CLR		R30
	RET

DECENAMINALARMA:
	LDI		ZL, LOW(Tabla7seg<<1)
	LDI		ZH, HIGH(Tabla7seg<<1) // RESETEAMOS A DONDE APUNTA Z
	;LDS	R16, DECMINALARM
	CPSE	R30, R16
	ADIW	Z, 1
	CPSE	R30, R16
	INC		R30
	CP		R30, R16
	BRNE	DECENAMINALARMA
	LPM		R29, Z
	CLR		R30
	RET 


UNIDADMINALARMA:
	LDI		ZL, LOW(Tabla7seg<<1)
	LDI		ZH, HIGH(Tabla7seg<<1)// RESETEAMOS A DONDE APUNTA Z
	;LDS	R16, UNIMINALARM
	CPSE	R30, R16
	ADIW	Z, 1
	CPSE	R30, R16
	INC		R30
	CP		R30, R16
	BRNE	UNIDADMINALARMA
	LPM		R29, Z
	CLR		R30
	RET 