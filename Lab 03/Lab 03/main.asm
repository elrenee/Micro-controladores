;
; Prelab_03.asm
;
; Created: 16/02/2025 16:49:10
; Author : Barbaritos
;
.include "M328PDEF.inc"

.cseg //lo que sigue es codigo
.org 0x0000
	JMP PILA
.org	PCI0addr //mascara de puerto B 
	JMP INTERRUPCION
.org	OVF0addr
	JMP INCREMENTAR10MS
PILA:
// coonfigurams la pila
LDI R16, LOW(RAMEND)
OUT SPL, R16
LDI R16, HIGH(RAMEND)
OUT SPH, R16
//configuramos el MCU
SETUP:
	LDI R16, (1<< CLKPCE)
	STS CLKPR, R16 //HABILITE CAMBIOS DEL PRESCALER
	LDI R16, 0b00000100
	STS CLKPR, R16 //nUESTRO TIMER TRABAJARA A 1MHz

	CALL START_TIMR0

	Tabla7seg: .DB 0x3F, 0x06, 0x5B, 0x4F, 0x66, 0x6D, 0x7D, 0x07, 0x7F, 0x6F

	CLI

	LDI R16, 0XFF
	OUT DDRC, R16 //pUERTO C COMO SALIDA
	LDI R16, 0X00
	OUT PORTC, R16 //0V EN LOS PINES DE NUESTRA SALIDA

	LDI R16, 0XFF
	OUT DDRD, R16
	LDI R16, 0X00
	OUT PORTD, R16


	OUT DDRB, R16 //PUERTO B COMO ENTRADA 
	LDI R16, 0XFF
	OUT PORTB, R16 //PULLUP HABILITADOS EN EL PUERTO B 

	LDI R16, (1<< PCIE0)
	STS PCICR, R16 //REGISTRO DE INTERRUPCIONES, HABILITADO PARA EL PUERTO B

	LDI R16, (1<< PCINT0) | (1<< PCINT1)
	STS PCMSK0, R16  //MASCARA PARA EL PUERTO B EN EL BIT 0 Y 1


	LDI R16, (1<< TOIE0)
	STS TIMSK0, R16

	SEI //ENCENDEMOS TODAS LAS INTERRUPCIONES GLOBALES 
	LDI R17, 0XFF //ESTADO ANTIGUO DE LOS BOTONES 
	LDI R19, 0X00
	LDI R21, 0X00
	LDI R22, 0X00 //ME SERVIRA PARA LAS DECENAS DE SEGUNDOS.
	LDI R24, 0X00 //ME SERVIRA PARA PODER SABER CUANTAS CASILLAS DEBO DE CORRER Z
	LDI R23, 0X00 //ME SERVIRA PARA CONTAR 20MS, CADA 20MS HARE EL TOGGLE DE LOS DISPLAYS
	LDI R26, 0X01
	LDI		ZL, LOW(Tabla7seg<<1)
	LDI		ZH, HIGH(Tabla7seg<<1)


MAIN:
	
	CPI R21, 0X0A
	BREQ LIMP //cADA 10 SEGUNDOS IRA A HACER ESTO (DEL 0 AL 9)
	//CPSE R23, R26 //CADA 20MS 
	//RJMP MAIN
	CALL TOOGLE
	RJMP MAIN

LIMP: 
	LDI		ZL, LOW(Tabla7seg<<1)
	LDI		ZH, HIGH(Tabla7seg<<1)
	CLR		R21
	INC		R22 // AUMENTARA LAS DECENAS 
	RJMP MAIN



INCREMENTAR10MS:
	INC R19
	INC R23
	CPI R19, 0X64
	BREQ CONT
	RETI
CONT:
	ADIW Z,1 
	CLR R19
	INC R21 // 1 SEG
	RETI


TOOGLE:
	LDI		ZL, LOW(Tabla7seg<<1)
	LDI		ZH, HIGH(Tabla7seg<<1)
	OUT PORTD, R25
	CALL TIEMPO
	CALL TIEMPO
	CALL DECENAS
	CBI PINC, 5
	SBI PINC, 4
	OUT PORTD, R20
	CALL TIEMPO
	CALL TIEMPO
	CALL TIEMPO
	OUT PORTD, R25
	CALL TIEMPO
	CALL TIEMPO
	CALL TIEMPO
	LDI		ZL, LOW(Tabla7seg<<1)
	LDI		ZH, HIGH(Tabla7seg<<1)
	CPSE	R24, R21
	CALL	SEG
	SBI  PINC, 5
	CBI PINC, 4
	OUT PORTD, R20
	CALL TIEMPO
	RET



DECENAS :
	CPSE	R24, R22
	ADIW	Z, 1
	CPSE	R24, R22
	INC		R24
	CP		R24, R22
	BRNE	DECENAS
	LPM R20, Z 
	CLR		R24
	RET 
SEG:
	CPSE R24, R21
	ADIW Z, 1
	CPSE R24, R21
	INC R24 
	CP R24, R21 
	BRNE SEG
	LPM R20, Z
	CLR R24
	RET

INTERRUPCION:
	PUSH R16
	IN R16, SREG
	PUSH R16

	IN R16, PINB 

	SBRS	R17, PB0 // SI EL ESTADO ANTERIOR ERA 1
	SBRC	R16, PB0 //Y EL ESTADO ACTUAL ES 0  
	INC		R18


	SBRC	R17, PB0 //SI EL ESTADO ANTERIOR ERA 0
	SBRS	R16, PB0 // Y EL ESTADO ACTUAL ES 1
	INC		R18 //FLANCO DE SUBIDA 


	;MISMA LOGICA CON EL PCINT1 (BIT1)
	SBRS	R17, PB1
	SBRC	R16, PB1
	DEC		R18

	SBRC	R17, PB1
	SBRS	R16, PB1
	DEC		R18
	MOV		R17, R16 //NUESTRO ESTADO ACTUAL SERA EL NUEVO ESTADO VIEJO.

	POP		R16
	OUT		SREG, R16
	POP		R16
	OUT PORTC, R18
	RETI


START_TIMR0:
	LDI		R16, 0b00000011 //PRESCALER QUE QUEREMOS =64 PARA 10MS
	OUT		TCCR0B, R16 //LE CARGAMOS ESE PRESCALER DE 0 A 64
	LDI		R16, 100
	OUT		TCNT0, R16
	RET


TIEMPO:
	LDI R25, 0X00
SUBTIEMPO:
	INC R25
	CPI R25, 0X00
	BRNE SUBTIEMPO
	RET 