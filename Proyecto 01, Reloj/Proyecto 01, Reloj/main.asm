; Proyecto 01, Reloj.asm
;
; Created: 24/02/2025 16:40:39
; Author : RenИ David GonzАlez Herrera
; Carnet: 23365

.include "M328PDEF.inc"

.cseg 
.org 0x0000
	JMP PILA
.org 0X0020
	JMP MEDIOSEG
PILA:

LDI R16, LOW(RAMEND)
OUT SPL, R16
LDI R16, HIGH(RAMEND)
OUT SPH, R16


SETUP:
	LDI R16, (1<< CLKPCE)
	STS CLKPR, R16 //HABILITE CAMBIOS DEL PRESCALER
	LDI R16, 0b00001000 //PRESCALER DE 256
	STS CLKPR, R16 //nUESTRO TIMER TRABAJARA A 62.5 KHz
	
	CALL INICIAR_TIMER0

	Tabla7seg: .DB 0x3F, 0x06, 0x5B, 0x4F, 0x66, 0x6D, 0x7D, 0x07, 0x7F, 0x6F

	//PUERTO D COMO SALIDA.
	LDI		R16, 0XFF
	OUT		DDRD, R16
	LDI		R16, 0X00
	OUT		PORTD, R16


	CLI //INTERRUPCIONES GLOBALES DESACTIVADAS  
	
	LDI		R16, (1<< TOIE0)
	STS		TIMSK0, R16

	SEI //INT GLOB ACTIVADAS 

	LDI		R17, 0X00 // 0.5 SEGUNDOS
	LDI		R22, 0X00 //1 MINUTO
	LDI		R19, 0X00 //CARGARE Z AQUI
	LDI		R20, 0X00 //DECENAS DE MIN
	LDI		R21, 0X00

	
	LDI ZL, LOW(Tabla7seg<<1)
	LDI ZH, HIGH(Tabla7seg<<1)


MAINLOOP:
	CPI R22, 0X0A
	BREQ LIMP
	//CALL TOOGLE
	RJMP MAINLOOP

LIMP: 
	LDI		ZL, LOW(Tabla7seg<<1)
	LDI		ZH, HIGH(Tabla7seg<<1)
	CLR		R22
	INC		R20 // AUMENTARA LAS DECENAS DE MIN
	RJMP MAINLOOP
	
MEDIOSEG:
	LDI		R16, 134
	OUT		TCNT0, R16
	INC		R17
	SBI		PIND, 0
	CPI		R17, 0X78 // 60 SEG
	BREQ	MINUTES
	RET

MINUTES:
	INC		R22
	SBI		PIND, 1
	RET

INICIAR_TIMER0:
	LDI		R16, (1	<<	CS02) //PRESCALER DE 256
	OUT		TCCR0B, R16 //LE CARGAMOS ESE PRESCALER DE 0 A 64
	LDI		R16, 0X00
	OUT		TCNT0, R16
	RET
